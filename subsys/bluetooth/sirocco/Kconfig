## subsys/bluetooth/sirocco/Kconfig
```kconfig
# Sirocco configuration options

menuconfig BT_SIROCCO
	bool "Sirocco Bluetooth IDS"
	depends on BT_LL_SW_SPLIT
    #&& CONFIG_SYS_HASH_MAP && CONFIG_SYS_HASH_FUNC32 && CONFIG_HEAP_MEM_POOL_SIZE && CONFIG_NRFX_TIMER2
	help
	  This option enables the Sirocco Bluetooth intrusion detection system.

    config BT_SRCC_LOG_LEVEL
    int "Sirocco Logging Level"
    default 3
    depends on LOG && BT_SIROCCO
    help
      This sets the logging level for the Sirocco module.
      0 - No log
      1 - Error
      2 - Warning
      3 - Info
      4 - Debug

if BT_SIROCCO

rsource "detection/Kconfig"

config SRCC_FIFO_LATENCY
    bool "Sirocco FIFO latency analysis"
	depends on SRCC_ANALYSIS && BT_SIROCCO
	help
	  This option enables the latency analysis for FIFO between BLE ISRs and Sirocco main thread.

config SRCC_E2E_LATENCY
    bool "Sirocco End to End latency analysis"
	depends on SRCC_ANALYSIS && BT_SIROCCO
    help
      This option enables the latency analysis between when the BLE packet is received to data is proceed.

endif # BT_SIROCCO
```

## subsys/bluetooth/sirocco/detection/Kconfig
```kconfig
# Detection module configuration options

config BT_SRCC_BTLEJACK
    bool "Sirocco BTLEJack module"
    depends on BT_SIROCCO
    help
        Enable BTLEJack detection module

config BT_SRCC_BTLEJUICE
    bool "Sirocco BTLEJuice module"
    depends on BT_SIROCCO
    help
        Enable BTLEJuice detection module

config BT_SRCC_OASIS_GATTACKER
    bool "Oasis GATTacker module"
    depends on BT_SIROCCO
    help
        Enable Oasis GATTacker detection module

config BT_SRCC_GATTACKER
    bool "Sirocco GATTacker module"
    depends on BT_SIROCCO
    help
        Enable GATTacker detection module

config BT_SRCC_INJECTABLE
    bool "Sirocco InjectaBLE module"
    depends on BT_SIROCCO
    help
        Enable InjectaBLE detection module

config BT_SRCC_JAMMING
    bool "Sirocco jamming module"
    depends on BT_SIROCCO
    help
        Enable jamming detection module

config BT_SRCC_KNOB
    bool "Sirocco KNOB module"
    depends on BT_SIROCCO
    help
        Enable KNOB detection module

config BT_SRCC_ALL
    bool "All detection modules"
    select BT_SRCC_BTLEJACK
    select BT_SRCC_BTLEJUICE
    select BT_SRCC_GATTACKER
    select BT_SRCC_INJECTABLE
    select BT_SRCC_JAMMING
    select BT_SRCC_KNOB
    help
      Enable all detection modules
```
